## Documentation/devicetree/bindings/barebox/barebox,state.txt
```
barebox,state
=============

A state node contains a description of a set of variables along with
a place where the variables are stored.

Required properties:
- compatible: should be "barebox,state";
- magic: A 32bit number used as a magic to identify the state

Optional properties:
- backend: describes where the data for this state is stored
- backend-type: should be "raw" or "dtb".

Variable nodes
==============

These are subnodes of a state node each describing a single variable.

Required properties:
- type: Should be "uint32", "enum32" or "mac" for the type of the variable
- names: For enum32 values only, this specifies the values possible for enum32.

Optional properties:
- default: The default value if the variable cannot be read from storage. For
           enum32 values it is an integer representing an offset into the names
	   array.

state: state@0 {
	magic = <0x27031977>;
	compatible = "barebox,state";
	backend-type = "raw";
	backend = &eeprom, "partname:state";

	bootcount@0 {
		type = "u32";
		default = <0x0>;
	};

	bootsource@1 {
		type = "enum32";
		names = "mmc", "nand";
		default ="mmc";
	};
};
```

## arch/arm/configs/globalscale_mirabox_defconfig
```kconfig
CONFIG_ARCH_MVEBU=y
CONFIG_THUMB2_BAREBOX=y
CONFIG_ARM_UNWIND=y
CONFIG_MMU=y
CONFIG_TEXT_BASE=0x0
CONFIG_MALLOC_SIZE=0x0
CONFIG_MALLOC_TLSF=y
CONFIG_KALLSYMS=y
CONFIG_RELOCATABLE=y
CONFIG_LONGHELP=y
CONFIG_GLOB=y
CONFIG_GLOB_SORT=y
CONFIG_HUSH_FANCY_PROMPT=y
CONFIG_HUSH_GETOPT=y
CONFIG_CMDLINE_EDITING=y
CONFIG_AUTO_COMPLETE=y
CONFIG_CONSOLE_ACTIVATE_NONE=y
CONFIG_PARTITION=y
CONFIG_DEBUG_LL=y
CONFIG_CMD_LOADY=y
CONFIG_CMD_LOADS=y
CONFIG_CMD_RESET=y
CONFIG_CMD_TIMEOUT=y
CONFIG_CMD_PARTITION=y
CONFIG_CMD_MAGICVAR=y
CONFIG_CMD_MAGICVAR_HELP=y
CONFIG_CMD_UNCOMPRESS=y
CONFIG_CMD_SPI=y
CONFIG_CMD_CLK=y
CONFIG_OFDEVICE=y
CONFIG_OF_BAREBOX_DRIVERS=y
CONFIG_DRIVER_SERIAL_NS16550=y
```

## arch/arm/configs/pm9263_defconfig
```kconfig
CONFIG_ARCH_AT91SAM9263=y
CONFIG_MACH_PM9263=y
CONFIG_AEABI=y
CONFIG_ARM_OPTIMZED_STRING_FUNCTIONS=y
CONFIG_ARM_UNWIND=y
CONFIG_MALLOC_TLSF=y
CONFIG_KALLSYMS=y
CONFIG_LONGHELP=y
CONFIG_GLOB=y
CONFIG_GLOB_SORT=y
CONFIG_PROMPT_HUSH_PS2="y"
CONFIG_HUSH_FANCY_PROMPT=y
CONFIG_HUSH_GETOPT=y
CONFIG_CMDLINE_EDITING=y
CONFIG_AUTO_COMPLETE=y
CONFIG_PARTITION=y
CONFIG_DEFAULT_ENVIRONMENT_PATH="arch/arm/boards/pm9263/env/"
CONFIG_CMD_EDIT=y
CONFIG_CMD_SLEEP=y
CONFIG_CMD_MSLEEP=y
CONFIG_CMD_SAVEENV=y
CONFIG_CMD_EXPORT=y
CONFIG_CMD_PRINTENV=y
CONFIG_CMD_READLINE=y
CONFIG_CMD_LN=y
CONFIG_CMD_TIME=y
CONFIG_CMD_GLOBAL=y
CONFIG_CMD_AUTOMOUNT=y
CONFIG_CMD_BASENAME=y
CONFIG_CMD_DIRNAME=y
CONFIG_CMD_READLINK=y
CONFIG_CMD_TFTP=y
CONFIG_CMD_ECHO_E=y
CONFIG_CMD_MEMINFO=y
CONFIG_CMD_IOMEM=y
CONFIG_CMD_CRC=y
CONFIG_CMD_CRC_CMP=y
CONFIG_CMD_FLASH=y
CONFIG_CMD_BOOTM_SHOW_TYPE=y
CONFIG_CMD_BOOTM_VERBOSE=y
CONFIG_CMD_BOOTM_INITRD=y
CONFIG_CMD_BOOTM_OFTREE=y
CONFIG_CMD_BOOTM_OFTREE_UIMAGE=y
# CONFIG_CMD_BOOTU is not set
CONFIG_CMD_RESET=y
CONFIG_CMD_GO=y
CONFIG_CMD_OFTREE=y
CONFIG_CMD_MTEST=y
CONFIG_CMD_MTEST_ALTERNATIVE=y
CONFIG_CMD_TIMEOUT=y
CONFIG_CMD_PARTITION=y
CONFIG_CMD_MAGICVAR=y
CONFIG_CMD_MAGICVAR_HELP=y
CONFIG_CMD_GPIO=y
CONFIG_CMD_UNCOMPRESS=y
CONFIG_NET=y
CONFIG_NET_DHCP=y
CONFIG_NET_PING=y
CONFIG_DRIVER_NET_MACB=y
# CONFIG_SPI is not set
CONFIG_DRIVER_CFI=y
CONFIG_CFI_BUFFER_WRITE=y
CONFIG_W1=y
CONFIG_W1_MASTER_GPIO=y
CONFIG_FS_TFTP=y
```

## arch/arm/mach-lpc3250/Kconfig
```kconfig
if ARCH_LPC3250

config ARCH_TEXT_BASE
        hex
	default 0x83f00000 if MACH_SYSTEC_LPC3250

config BOARDINFO
	default "Systec LPC3250" if MACH_SYSTEC_LPC3250

choice

	prompt "Board Type"

config MACH_SYSTEC_LPC3250
	bool "Systec LPC3250"
	select MACH_HAS_LOWLEVEL_INIT
	select HAVE_MMU

endchoice

endif
```

## drivers/spi/Kconfig
```kconfig
menu "SPI drivers                   "

config SPI
	bool "Enable SPI driver support"
	default y

if SPI

config DRIVER_SPI_ALTERA
	bool "Altera SPI Master driver"
	depends on NIOS2

config DRIVER_SPI_ATMEL
	bool "Atmel (AT91) SPI Master driver"
	depends on ARCH_AT91

config DRIVER_SPI_IMX
	bool "i.MX SPI Master driver"
	depends on ARCH_IMX

config DRIVER_SPI_ALTERA
	bool "Altera SPI Master driver"
	depends on NIOS2
	depends on SPI

config DRIVER_SPI_ATMEL
	bool "Atmel (AT91) SPI Master driver"
	depends on ARCH_AT91
	depends on SPI

config DRIVER_SPI_OMAP3
	bool "OMAP3 McSPI Master driver"
	depends on ARCH_OMAP3

endif

endmenu
```
